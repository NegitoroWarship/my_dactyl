## boards/sekigon/bmp_boost/Kconfig.bmp_boost
```kconfig
# SPDX-License-Identifier: MIT

config BOARD_BMP_BOOST
    select ZMK_BOARD_COMPAT if BOARD_BMP_BOOST_NRF52840_ZMK
```

## boards/sekigon/bmp_boost/board.yml
```yaml
board:
  extend: bmp_boost
  variants:
    - name: zmk
      qualifier: nrf52840
```
