#include "sakoa_dactyl.dtsi"

&kscan0 {
    /*
     * Diagnostic: address the nRF52840 GPIO controllers directly instead of
     * relying on the BMP Boost Pro Micro connector GPIO map.
     * C0..C6: BMP Boost silk 5/A3, 0, 30/A6, 3/A1, 46, 47, 10.
     */
    col-gpios
        = <&gpio0 5 GPIO_ACTIVE_HIGH>
        , <&gpio0 0 GPIO_ACTIVE_HIGH>
        , <&gpio0 30 GPIO_ACTIVE_HIGH>
        , <&gpio0 3 GPIO_ACTIVE_HIGH>
        , <&gpio1 14 GPIO_ACTIVE_HIGH>
        , <&gpio1 15 GPIO_ACTIVE_HIGH>
        , <&gpio0 10 GPIO_ACTIVE_HIGH>
        ;

    /* R0..R5: BMP Boost silk 19, 20, 22, 23, 32, 35 */
    row-gpios
        = <&gpio0 19 (GPIO_ACTIVE_HIGH | GPIO_PULL_DOWN)>
        , <&gpio0 20 (GPIO_ACTIVE_HIGH | GPIO_PULL_DOWN)>
        , <&gpio0 22 (GPIO_ACTIVE_HIGH | GPIO_PULL_DOWN)>
        , <&gpio0 23 (GPIO_ACTIVE_HIGH | GPIO_PULL_DOWN)>
        , <&gpio1 0 (GPIO_ACTIVE_HIGH | GPIO_PULL_DOWN)>
        , <&gpio1 3 (GPIO_ACTIVE_HIGH | GPIO_PULL_DOWN)>
        ;
};

/* Left occupies global columns 0..5, so right begins at global column 6. */
&default_transform {
    col-offset = <6>;
};
