## boards/shields/sakoa_dactyl/Kconfig.defconfig
```kconfig
if SHIELD_SAKOA_DACTYL_LEFT

config ZMK_KEYBOARD_NAME
    default "Sakoa Dactyl"

config ZMK_SPLIT_ROLE_CENTRAL
    default y

endif

if SHIELD_SAKOA_DACTYL_LEFT || SHIELD_SAKOA_DACTYL_RIGHT

config ZMK_SPLIT
    default y

endif
```

## boards/shields/sakoa_dactyl/Kconfig.shield
```kconfig
config SHIELD_SAKOA_DACTYL_LEFT
    def_bool $(shields_list_contains,sakoa_dactyl_left)

config SHIELD_SAKOA_DACTYL_RIGHT
    def_bool $(shields_list_contains,sakoa_dactyl_right)
```

## boards/shields/sakoa_gpio_logger/Kconfig.defconfig
```kconfig
if SHIELD_SAKOA_GPIO_LOGGER

config ZMK_KEYBOARD_NAME
    default "GPIO Logger"

config ZMK_BLE
    def_bool n

config SETTINGS
    def_bool n

endif
```

## boards/shields/sakoa_gpio_logger/Kconfig.shield
```kconfig
config SHIELD_SAKOA_GPIO_LOGGER
    def_bool $(shields_list_contains,sakoa_gpio_logger)
```

## boards/shields/sakoa_usb_auto_test/Kconfig.defconfig
```kconfig
if SHIELD_SAKOA_USB_AUTO_TEST

config ZMK_KEYBOARD_NAME
    default "USB Auto Test"

config ZMK_BLE
    def_bool n

config SETTINGS
    def_bool n

endif
```

## boards/shields/sakoa_usb_auto_test/Kconfig.shield
```kconfig
config SHIELD_SAKOA_USB_AUTO_TEST
    def_bool $(shields_list_contains,sakoa_usb_auto_test)
```
